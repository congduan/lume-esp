## firmware/components/lume-board/Kconfig.projbuild
```kconfig
menu "Lume board"

    config LUME_LCD_PCLK_MHZ
        int "CO5300 QSPI pixel clock (MHz)"
        range 20 80
        default 40
        help
            QSPI clock for the CO5300 panel. 40 MHz is the value used by the
            Waveshare BSP, the Brookesia examples and the esp_lcd_co5300
            component's own QSPI macro default — the only speed with prior
            art on this panel. The datasheet permits up to 50 MHz (20 ns
            minimum write cycle); 80 is an experimental overclock kept as a
            Kconfig option, pending board validation. If the panel shows
            corruption or instability, step down towards 40.

    choice LUME_BOARD
        prompt "Lume target board"
        default LUME_BOARD_WAVESHARE_ESP32_S3_TOUCH_AMOLED_2_16
        help
            Select the hardware board profile compiled into the firmware.
            Each board supplies its pin map, display geometry, I2C addresses,
            QSPI timing and panel init sequence as compile-time constants in
            firmware/boards/<CONFIG_LUME_BOARD_DIR>/lume_board_profile.h.
            See firmware/boards/README.md for how to add a board.
        config LUME_BOARD_WAVESHARE_ESP32_S3_TOUCH_AMOLED_2_16
            bool "Waveshare ESP32-S3-Touch-AMOLED-2.16"
        config LUME_BOARD_WAVESHARE_ESP32_S3_TOUCH_AMOLED_1_8
            bool "Waveshare ESP32-S3-Touch-AMOLED-1.8 (V2 CO5300/CST820)"
            help
                Second compile-time board profile (r44). 368x448 CO5300 with
                a 16-column gap and a CST820 touch controller. Compile-time
                only: the touch/reset/gap/SD driver paths are not yet adapted
                and no on-device acceptance has happened - see
                docs/KNOWN-SIMPLIFICATIONS.md (r44).
    endchoice

    # Hidden: derived from the choice, consumed by lume-board/CMakeLists.txt
    # to put the selected board's profile header on the public include path.
    config LUME_BOARD_DIR
        string
        default "waveshare_esp32_s3_touch_amoled_2_16" if LUME_BOARD_WAVESHARE_ESP32_S3_TOUCH_AMOLED_2_16
        default "waveshare_esp32_s3_touch_amoled_1_8" if LUME_BOARD_WAVESHARE_ESP32_S3_TOUCH_AMOLED_1_8
        help
            Directory under firmware/boards/ that holds the selected profile.
            Add a "default <dir> if LUME_BOARD_<NEW>" line when adding a board.

endmenu
```

## firmware/components/lume-net/Kconfig.projbuild
```kconfig
menu "Lume local web server (r71)"
    config LUME_WEB_PORT
        int "Local web server default listen port"
        default 8080
        range 1024 65535
        help
            Default TCP port for the JS-defined LAN web server. The server is
            OFF by default and only binds while the WiFi station has an IPv4
            address and an app explicitly called lume.net.web.start({token}).
            The app may override the port in start() (1024-65535). Independent
            of the WiFi OTA port (CONFIG_LUME_OTA_PORT, 8765).
endmenu
```

## firmware/components/lume-perf/Kconfig
```kconfig
menu "Lume performance experiments"
    config LUME_PERF_PROFILE
        bool "One-second performance summary"
        default n
    config LUME_DRAW_BUF_LINES
        int "Preferred DMA draw buffer height (20 or 48)"
        range 20 48
        default 20
    config LUME_REFRESH_PERIOD_MS
        int "LVGL refresh period in milliseconds (10, 15, or 33)"
        range 10 33
        default 33
    config LUME_SWITCH_PROFILE
        bool "r46: log per-phase app-switch timing (opt-in measurement, default off)"
        default n
        help
          Emits one lume-perf "switch:" line per app switch with teardown
          (JS_FreeRuntime broken out), runtime creation (NewRuntime2 /
          NewContext / register_bindings broken out), prelude eval and app
          eval phases, plus SWMARK checkpoints and an LVGL-side first-frame
          latency line. Uses emulated microseconds (deterministic under
          esp32sim), NOT wall-clock. Off by default: no production overhead.
endmenu

menu "Lume app-switch transition (r46)"
    config LUME_APP_TRANSITION_DISABLE
        bool "Disable crossfade-through-black (=y: behave like pre-r46 baseline)"
        default n
        help
          Regression switch. When enabled, launch/reload tears down and
          rebuilds exactly as before r46 (synchronous RESET, blank period,
          no overlay, no fade). The engine does not wait for any cover
          handshake and does not post the FIRSTFRAME reveal trigger.
    config LUME_APP_TRANSITION_MS
        int "Crossfade fade-in / fade-out duration (ms)"
        range 100 500
        default 200
        help
          Duration of each opacity fade on the LVGL task. The overlay fades
          in to opaque black before teardown and back out after the new
          app's first frame. 500 ms is a fixed LVGL-side reveal fallback.
endmenu
```
